## Kconfig
```kconfig
#  This file is part of LiTE.
#
#  This library is free software; you can redistribute it and/or
#  modify it under the terms of the GNU Lesser General Public
#  License as published by the Free Software Foundation; either
#  version 2.1 of the License, or (at your option) any later version.
#
#  This library is distributed in the hope that it will be useful,
#  but WITHOUT ANY WARRANTY; without even the implied warranty of
#  MERCHANTABILITY or FITNESS FOR A PARTICULAR PURPOSE.  See the GNU
#  Lesser General Public License for more details.
#
#  You should have received a copy of the GNU Lesser General Public
#  License along with this library; if not, write to the Free Software
#  Foundation, Inc., 51 Franklin Street, Fifth Floor, Boston, MA 02110-1301, USA

menuconfig GRAPHICS_LITE
	bool "LiTE"
	default n
	depends on GRAPHICS_DIRECTFB2
	---help---
		Enable support for LiTE.

if GRAPHICS_LITE

config LITE_FONT_EXTENSION
	string "Font extension"
	default "dgiff"

config LITE_FONT_PROVIDER
	string "Font provider"
	default "DGIFF"

config LITE_IMAGE_EXTENSION
	string "Image extension"
	default "dfiff"

config LITE_IMAGE_PROVIDER
	string "Image provider"
	default "DFIFF"

endif
```
